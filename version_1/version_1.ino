#include <Adafruit_GFX.h>
#include <Adafruit_SSD1306.h>
#include <OneButton.h>
#include <Adafruit_INA219.h>


#define SCREEN_WIDTH 128 // OLED display width, in pixels
#define SCREEN_HEIGHT 32 // OLED display height, in pixels
#define OLED_RESET     -1 // Reset pin # (or -1 if sharing Arduino reset pin)
#define SCREEN_ADDRESS 0x3C ///< See datasheet for Address; 0x3D for 128x64, 0x3C for 128x32

int led = 12;
int in1 = 7;
int in2 = 8;
int pb1 = 9;
int pb2 = 10;
int bat = A2;

int pic = -1;
int maxPics = 3;
int button_brd = A1;


OneButton button(button_brd,true);

Adafruit_SSD1306 display(SCREEN_WIDTH, SCREEN_HEIGHT, &Wire, OLED_RESET);
Adafruit_INA219 ina219;



// 'Pictogrammers-Material-Nail', 128x32px
// 'nail2', 128x32px
// 'nail3', 128x32px
const unsigned char nail3 [] PROGMEM = {
  0x00, 0x00, 0x00, 0x00, 0x00, 0x00, 0x00, 0x00, 0x00, 0x00, 0x00, 0x00, 0x00, 0x00, 0x00, 0x00, 
  0x00, 0x1e, 0x00, 0x00, 0x00, 0x00, 0x00, 0x00, 0x00, 0x00, 0x00, 0x00, 0x00, 0x00, 0x00, 0x00, 
  0x00, 0xfe, 0x00, 0x00, 0x00, 0x00, 0x00, 0x00, 0x00, 0x00, 0x00, 0x00, 0x00, 0x00, 0x00, 0x00, 
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  0x00, 0x0c, 0x00, 0x00, 0x00, 0x00, 0x00, 0x00, 0x00, 0x00, 0x00, 0x00, 0x00, 0x00, 0x00, 0x00
};

// Array of all bitmaps for convenience. (Total bytes used to store images in PROGMEM = 528)
const int nail3allArray_LEN = 1;
const unsigned char* nail3allArray[1] = {
  nail3
};



// '0', 128x32px
const unsigned char zero_before [] PROGMEM = {
  0x00, 0x00, 0x00, 0x00, 0x00, 0x00, 0x00, 0x00, 0x00, 0x00, 0x00, 0x00, 0x00, 0x00, 0x00, 0x00, 
  0x00, 0x0f, 0xff, 0xf8, 0x00, 0x00, 0x00, 0x00, 0x00, 0x00, 0x00, 0x00, 0x00, 0x00, 0x00, 0x00, 
  0x00, 0x7f, 0xff, 0xff, 0x80, 0x00, 0x00, 0x00, 0x00, 0x00, 0x00, 0x00, 0x00, 0x00, 0x00, 0x00, 
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  0x00, 0x00, 0x00, 0x00, 0x00, 0x00, 0x00, 0x00, 0x00, 0x00, 0x00, 0x00, 0x00, 0x00, 0x00, 0x00
};

// Array of all bitmaps for convenience. (Total bytes used to store images in PROGMEM = 528)
const int zero_beforeallArray_LEN = 1;
const unsigned char* zero_beforeallArray[1] = {
  zero_before
};



// '0', 128x32px
const unsigned char zero_after [] PROGMEM = {
  0x00, 0x00, 0x00, 0x00, 0x00, 0x00, 0x00, 0x00, 0x00, 0x00, 0x00, 0x00, 0x00, 0x00, 0x00, 0x00, 
  0x00, 0x0f, 0xff, 0xf8, 0x00, 0x00, 0x00, 0x00, 0x00, 0x00, 0x00, 0x00, 0x00, 0x00, 0x00, 0x00, 
  0x00, 0x7f, 0xff, 0xff, 0x00, 0x00, 0x00, 0x00, 0x00, 0x00, 0x00, 0x00, 0x00, 0x00, 0x00, 0x00, 
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  0x00, 0x00, 0x00, 0x00, 0x00, 0x00, 0x00, 0x00, 0x00, 0x00, 0x00, 0x00, 0x00, 0x00, 0x00, 0x00
};

// Array of all bitmaps for convenience. (Total bytes used to store images in PROGMEM = 528)
const int zero_afterallArray_LEN = 1;
const unsigned char* zero_afterallArray[1] = {
  zero_after
};



// '1', 128x32px
const unsigned char one_before [] PROGMEM = {
  0x00, 0x00, 0x00, 0x00, 0x00, 0x00, 0x00, 0x00, 0x00, 0x00, 0x00, 0x00, 0x00, 0x00, 0x00, 0x00, 
  0x00, 0x0f, 0xff, 0xfc, 0x00, 0x00, 0x00, 0x00, 0x00, 0x00, 0x00, 0x00, 0x00, 0x00, 0x00, 0x00, 
  0x00, 0x7f, 0xff, 0xff, 0x80, 0x00, 0x00, 0x00, 0x00, 0x00, 0x00, 0x00, 0x00, 0x00, 0x00, 0x00, 
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  0x00, 0x00, 0x00, 0x00, 0x00, 0x00, 0x00, 0x00, 0x00, 0x00, 0x00, 0x00, 0x00, 0x00, 0x00, 0x00
};

// Array of all bitmaps for convenience. (Total bytes used to store images in PROGMEM = 528)
const int one_beforeallArray_LEN = 1;
const unsigned char* one_beforeallArray[1] = {
  one_before
};

// '1', 128x32px
const unsigned char one_after [] PROGMEM = {
  0x00, 0x00, 0x00, 0x00, 0x00, 0x00, 0x00, 0x00, 0x00, 0x00, 0x00, 0x00, 0x00, 0x00, 0x00, 0x00, 
  0x00, 0x03, 0xff, 0xf0, 0x00, 0x00, 0x00, 0x00, 0x00, 0x00, 0x00, 0x00, 0x00, 0x00, 0x00, 0x00, 
  0x00, 0x3f, 0xff, 0xff, 0x00, 0x00, 0x00, 0x00, 0x00, 0x00, 0x00, 0x00, 0x00, 0x00, 0x00, 0x00, 
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  0x00, 0x00, 0x00, 0x00, 0x00, 0x00, 0x00, 0x00, 0x00, 0x00, 0x00, 0x00, 0x00, 0x00, 0x00, 0x00
};

// Array of all bitmaps for convenience. (Total bytes used to store images in PROGMEM = 528)
const int one_afterallArray_LEN = 1;
const unsigned char* one_afterallArray[1] = {
  one_after
};



// '2', 128x32px
const unsigned char two_before [] PROGMEM = {
  0x00, 0x00, 0x00, 0x00, 0x00, 0x00, 0x00, 0x00, 0x00, 0x00, 0x00, 0x00, 0x00, 0x00, 0x00, 0x00, 
  0x00, 0x1f, 0xff, 0xfc, 0x00, 0x00, 0x00, 0x00, 0x00, 0x00, 0x00, 0x00, 0x00, 0x00, 0x00, 0x00, 
  0x00, 0x7f, 0xff, 0xff, 0x80, 0x00, 0x00, 0x00, 0x00, 0x00, 0x00, 0x00, 0x00, 0x00, 0x00, 0x00, 
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  0x00, 0x00, 0x00, 0x00, 0x00, 0x00, 0x00, 0x00, 0x00, 0x00, 0x00, 0x00, 0x00, 0x00, 0x00, 0x00
};

// Array of all bitmaps for convenience. (Total bytes used to store images in PROGMEM = 528)
const int two_beforeallArray_LEN = 1;
const unsigned char* two_beforeallArray[1] = {
  two_before
};


// '2', 128x32px
const unsigned char two_after [] PROGMEM = {
  0x00, 0x00, 0x00, 0x00, 0x00, 0x00, 0x00, 0x00, 0x00, 0x00, 0x00, 0x00, 0x00, 0x00, 0x00, 0x00, 
  0x00, 0x07, 0xff, 0xe0, 0x00, 0x00, 0x00, 0x00, 0x00, 0x00, 0x00, 0x00, 0x00, 0x00, 0x00, 0x00, 
  0x00, 0x7f, 0xff, 0xfe, 0x00, 0x00, 0x00, 0x00, 0x00, 0x00, 0x00, 0x00, 0x00, 0x00, 0x00, 0x00, 
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  0x00, 0x00, 0x00, 0x00, 0x00, 0x00, 0x00, 0x00, 0x00, 0x00, 0x00, 0x00, 0x00, 0x00, 0x00, 0x00
};

// Array of all bitmaps for convenience. (Total bytes used to store images in PROGMEM = 528)
const int two_afterallArray_LEN = 1;
const unsigned char* two_afterallArray[1] = {
  two_after
};









void setup() {
  // put your setup code here, to run once:
  Serial.begin(9600);
  
  if(!display.begin(SSD1306_SWITCHCAPVCC, SCREEN_ADDRESS)) {
    Serial.println(F("SSD1306 allocation failed"));
    for(;;); // Don't proceed, loop forever
  }

  if (! ina219.begin()) {
    Serial.println("Failed to find INA219 chip");
    while (1) { delay(10); }
  }

  pinMode(led,OUTPUT);
  pinMode(in1,OUTPUT);
  pinMode(in2,OUTPUT);
  pinMode(pb1,INPUT);
  pinMode(pb2,INPUT);
  pinMode(bat,INPUT);

  button.attachClick(click);
  button.attachDoubleClick(doubleclick);
  button.attachLongPressStart(longPressStart);
  
  digitalWrite(led,HIGH);
  
  display.clearDisplay();
  display.setTextSize(2); // Draw 2X-scale text
  display.setTextColor(SSD1306_WHITE);
  display.setCursor(10, 0);
  display.println(F("long press to menu"));
  display.display();
}

void loop() {
  // put your main code here, to run repeatedly:
  button.tick();
  
  float current_mA = 0;
  current_mA = ina219.getCurrent_mA();
  Serial.print("Current before:       "); Serial.print(current_mA); Serial.println(" mA");

  float battery_level = analogRead(A2);
  Serial.print("bat level: "); Serial.println(battery_level);


  if (digitalRead(pb1) && !digitalRead(pb2)){
    nail_backward();
    digitalWrite(in1,HIGH);
    digitalWrite(in2,LOW);
  }
  
  else if(digitalRead(pb2) && !digitalRead(pb1)){
    nail_forward();
    digitalWrite(in2,HIGH);
    digitalWrite(in1,LOW);
    Serial.print("Current:       "); Serial.print(current_mA); Serial.println(" mA");
    delay(400);
    if(pic==0){
      digitalWrite(in2,HIGH);
      digitalWrite(in1,LOW);
    }
    else if (pic==1){
      if(abs(current_mA)>110){
        digitalWrite(in1,LOW);
        digitalWrite(in2,LOW);
        display.clearDisplay();
        display.setTextSize(2); // Draw 2X-scale text
        display.setTextColor(SSD1306_WHITE);
        display.setCursor(10, 0);
        display.println(F("DONE!"));
        display.display();  
        delay(10000);
      }
    }
    else if (pic==2){
      if(abs(current_mA)>200){
        digitalWrite(in1,LOW);
        digitalWrite(in2,LOW);
        display.clearDisplay();
        display.setTextSize(2); // Draw 2X-scale text
        display.setTextColor(SSD1306_WHITE);
        display.setCursor(10, 0);
        display.println(F("DONE!"));
        display.display();  
        delay(10000);
      }
    }
    
  }

  else{
  //display.clearDisplay();
  //display.display();
  digitalWrite(in1,LOW);
  digitalWrite(in2,LOW);
  }
}


void nail_forward(){
  for (int i=20; i<55; i++){
    if(!digitalRead(pb2)){
      break;
    }
    display.clearDisplay();
    if(pic==0){
      display.drawBitmap(0,1,zero_after,128,32,WHITE);
    }
    else if (pic==1){
      display.drawBitmap(0,1,one_after,128,32,WHITE);
    }
    else if (pic==2){
      display.drawBitmap(0,1,two_after,128,32,WHITE);
    }
    display.drawBitmap(i,0,nail3,128,32,WHITE);
    display.display();
  }
}

void nail_backward(){
  for (int i=55; i>20; i--){
    if(!digitalRead(pb1)){
      break;
    }
    display.clearDisplay();
    display.drawBitmap(i,0,nail3,128,32,WHITE);
    display.display();
  }
}


void go_to_menu(){
  display.clearDisplay();
  //display.drawBitmap(0,1,two_after_2,128,32,WHITE);
  display.drawBitmap(0,1,zero_before,128,32,WHITE);
  display.drawBitmap(40,1,one_before,128,32,WHITE);
  display.drawBitmap(80,1,two_before,128,32,WHITE);
  display.display();
  
}

void click(){
  pic++;
  
  if(pic>maxPics-1){
    pic=0;
    display.clearDisplay();
    display.drawBitmap(0,1,zero_after,128,32,WHITE);
    display.drawBitmap(40,1,one_before,128,32,WHITE);
    display.drawBitmap(80,1,two_before,128,32,WHITE);
    display.display();
    
  }
  else{
    
    if(pic==0){
      display.clearDisplay();
      display.drawBitmap(0,1,zero_after,128,32,WHITE);
      display.drawBitmap(40,1,one_before,128,32,WHITE);
      display.drawBitmap(80,1,two_before,128,32,WHITE);
      display.display();
    }
    else if(pic==1){
      display.clearDisplay();
      display.drawBitmap(0,1,zero_before,128,32,WHITE);
      display.drawBitmap(40,1,one_after,128,32,WHITE);
      display.drawBitmap(80,1,two_before,128,32,WHITE);
      display.display();
    }
    else if(pic==2){
      display.clearDisplay();
      display.drawBitmap(0,1,zero_before,128,32,WHITE);
      display.drawBitmap(40,1,one_before,128,32,WHITE);
      display.drawBitmap(80,1,two_after,128,32,WHITE);
      display.display();
    }
    
  }
  Serial.println(pic);
  
}

void doubleclick(){
  state();
  
}

void longPressStart(){
  pic=-1;
  go_to_menu();
}

void state(){
  if(pic==0){
    display.clearDisplay();
    display.drawBitmap(0,1,zero_after,128,32,WHITE);
    display.display();
  }
  else if (pic==1){
    display.clearDisplay();
    display.drawBitmap(0,1,one_after,128,32,WHITE);
    display.display();
  }
  else if (pic==2){
    display.clearDisplay();
    display.drawBitmap(0,1,two_after,128,32,WHITE);
    display.display();
  }
}
